## conf/bblayers.conf
```bitbake
# LAYER_CONF_VERSION is increased each time build/conf/bblayers.conf
# changes incompatibly
POKY_BBLAYERS_CONF_VERSION = "2"

BBPATH = "${TOPDIR}"
BBFILES ?= ""

# A bit of explanation is probably in order.  While OE/Yocto pins
# things into a given user path when you run the OE init bash script
# and it does a bit of defaulting for this file.  This, unfortunately
# has the predictable need to blow out the config (which may have
# extra layers in there that you now have to add back in...sigh...).
#
# This is actually un-needed.  Inside this .conf file, .bb file
# metadata syntax and global bitbake variables apply.  ${TOPDIR}
# specifically refers to the directory in the structure within
# the directory structure that the bitbake command is issued in
# (i.e. build/) that is computed as fully qualified path name
# on the fly for any one given execution.  So, you can move this
# beast around.  You can pretty much, if you're using the oe_build
# manifest or like it, start building once you source the OE
# init script at the toplevel of the whole build system.
#
# In the large, you'll be editing this block (the one you have
# after this BBLAYERS block should probably be left alone unless
# you know what you're doing and actually NEED to adjust this.)
# and you'll add lines in the same manner as below to add a
# new metadata layer.
#
# FIXME : Temp removed layer and putting into comments so we can
#         basically start cleaning it up.  Claims "honister", but
#         there's no way in HELL it's that because it's got *OLD*
#         override syntax in there...
#
#             ${TOPDIR}/../meta-rockchip
#
BBLAYERS ?= " \
  ${TOPDIR}/../meta \
  ${TOPDIR}/../meta-poky \
  ${TOPDIR}/../meta-yocto-bsp \
  ${TOPDIR}/../meta-clang \
  ${TOPDIR}/../meta-mono \
  ${TOPDIR}/../meta-raspberrypi \
  ${TOPDIR}/../meta-riscv \
  ${TOPDIR}/../meta-sunxi \
  ${TOPDIR}/../meta-arm/meta-arm \
  ${TOPDIR}/../meta-arm/meta-arm-bsp \
  ${TOPDIR}/../meta-arm/meta-arm-systemready \
  ${TOPDIR}/../meta-arm/meta-arm-toolchain \
  ${TOPDIR}/../meta-meson \
  ${TOPDIR}/../meta-tegra \
  ${TOPDIR}/../meta-intel \
  ${TOPDIR}/../meta-rtlwifi \
  ${TOPDIR}/../meta-efl \
  ${TOPDIR}/../meta-openembedded/meta-oe \
  ${TOPDIR}/../meta-openembedded/meta-filesystems \
  ${TOPDIR}/../meta-openembedded/meta-networking \
  ${TOPDIR}/../meta-openembedded/meta-multimedia \
  ${TOPDIR}/../meta-openembedded/meta-python \
  ${TOPDIR}/../meta-openembedded/meta-perl \
  ${TOPDIR}/../meta-openembedded/meta-gnome \
  ${TOPDIR}/../meta-openembedded/meta-xfce \
  ${TOPDIR}/../meta-edgeml \
  ${TOPDIR}/../meta-linux-telephony \
  ${TOPDIR}/../meta-pha \
  ${TOPDIR}/../meta-runit \
  "

BBLAYERS_NON_REMOVABLE ?= " \
  ${TOPDIR}/../meta \
  ${TOPDIR}/../meta-poky \
  "
```
